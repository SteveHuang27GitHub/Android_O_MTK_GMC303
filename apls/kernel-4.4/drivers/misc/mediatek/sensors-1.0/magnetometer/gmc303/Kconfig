## apls/kernel-4.4/drivers/misc/mediatek/sensors-1.0/magnetometer/gmc303/Kconfig
```kconfig
config MTK_GMC303
	tristate "GMC303 for MediaTek package"
	default n
	help
	  It support different magnetometer sensor.
	  If this option is set, it will support
	  GMC303 magnetometer which is a 3-axis electronic
	  compass IC with high sensitive Hall sensor technology.
```
